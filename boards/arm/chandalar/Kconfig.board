## boards/arm/chandalar/Kconfig.board
```kconfig
# Chandalar board

# Copyright (c) 2020 Antmicro <www.antmicro.com>
# SPDX-License-Identifier: Apache-2.0

config BOARD_CHANDALAR
	bool "QuickLogic Chandalar target"
	depends on SOC_EOS_S3
```

## boards/arm/chandalar/Kconfig.defconfig
```kconfig
# QuickLogic Chandalar board

# Copyright (c) 2020 Antmicro <www.antmicro.com>
# SPDX-License-Identifier: Apache-2.0

if BOARD_CHANDALAR

config BOARD
	default "chandalar"

endif # BOARD_CHANDALAR
```

## boards/arm/mercury_xu/Kconfig.board
```kconfig
# Copyright (c) 2019, Antmicro
# SPDX-License-Identifier: Apache-2.0
config BOARD_MERCURY_XU_BOARD
	bool "Mercury XU Board"
	depends on SOC_XILINX_ZYNQMP
	select DISABLE_TCM_ECC
```

## boards/arm/mercury_xu/Kconfig.defconfig
```kconfig
# Copyright (c) 2019, Antmicro
# SPDX-License-Identifier: Apache-2.0

if BOARD_MERCURY_XU_BOARD

config BOARD
	default "mercury_xu_board"

config BUILD_OUTPUT_STRIPPED
	def_bool y

config FLASH_SIZE
	int
	default 64

config FLASH_BASE_ADDRESS
	default 0x08000000

endif
```

## boards/arm/mercury_xu/mercury_xu_board_defconfig
```kconfig
# Copyright (c) 2019, Antmicro
CONFIG_ARM=y
CONFIG_SOC_XILINX_ZYNQMP=y
CONFIG_BOARD_MERCURY_XU_BOARD=y

CONFIG_ISR_STACK_SIZE=1024
CONFIG_THREAD_STACK_INFO=y

# enable uart driver
CONFIG_SERIAL=y
CONFIG_UART_XLNX_PS=y

# enable console
CONFIG_CONSOLE=y
CONFIG_UART_CONSOLE=y

# enable timer
CONFIG_XLNX_PSTTC_TIMER=y
CONFIG_SYS_CLOCK_TICKS_PER_SEC=1000
```

## samples/drivers/clock_control_litex/sample.yaml
```yaml
sample:
  name: Sample for the clock control driver
tests:
  sample.driver.clock_control_litex:
    build_only: true
    platform_whitelist: litex_vexriscv
    tags: clock litex vexriscv mmcm
```
